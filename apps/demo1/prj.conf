## CMakeLists.txt
```
# SPDX-License-Identifier: Apache-2.0

cmake_minimum_required(VERSION 3.20.0)

find_package(Zephyr REQUIRED HINTS $ENV{ZEPHYR_BASE})

project(demo1)

target_sources(app PRIVATE src/sched_coop.c)
```

## prj.conf
```kconfig
CONFIG_PRINTK=y
CONFIG_HEAP_MEM_POOL_SIZE=256

CONFIG_SCHED_DEADLINE=y
```

## src/sched_coop.c
```c
/*
 * Copyright (c) 2017 Linaro Limited
 *
 * SPDX-License-Identifier: Apache-2.0
 */

#include <zephyr/zephyr.h>
#include <zephyr/device.h>
#include <zephyr/sys/printk.h>
#include <zephyr/kernel/thread_stack.h>
#include <string.h>

#define STACK_SIZE 1024

#define H_PRIORITY 3
#define M_PRIORITY 5
#define L_PRIORITY 7

#define CH_PRIORITY -3
#define CM_PRIORITY -2
#define CL_PRIORITY -1

struct k_thread t1_thread_data;
struct k_thread t2_thread_data;
struct k_thread t3_thread_data;

K_THREAD_STACK_DEFINE(t1_stack_area, STACK_SIZE);
K_THREAD_STACK_DEFINE(t2_stack_area, STACK_SIZE);
K_THREAD_STACK_DEFINE(t3_stack_area, STACK_SIZE);

void counter_thread(void * n, void * e, void * unused)
{
	int id = (int)n;
	int limit = (int)e;
	printk("T%d: HELLO\n", id);
	for (int i = 0; i < limit * 1000000; i++) {
		if (i % 1000000 == 0) {
			printk("T%d\n", id);
		}
	}
	printk("T%d: BYE\n", id);
}

int main()
{
	k_tid_t t1_tid = k_thread_create(&t1_thread_data, t1_stack_area,
					 K_THREAD_STACK_SIZEOF(t1_stack_area), 
					 counter_thread, ((void *)1), ((void *)1), NULL, CH_PRIORITY, 0, K_MSEC(800));

	k_tid_t t2_tid = k_thread_create(&t2_thread_data, t2_stack_area,
					 K_THREAD_STACK_SIZEOF(t2_stack_area), 
					 counter_thread, ((void*)2), ((void*)5), NULL, CM_PRIORITY, 0, K_MSEC(10));

	k_tid_t t3_tid = k_thread_create(&t3_thread_data, t3_stack_area,
					 K_THREAD_STACK_SIZEOF(t3_stack_area), 
					 counter_thread, ((void*)3), ((void*)10), NULL, CL_PRIORITY, 0, K_NO_WAIT);
	return 0;
}
```

## src/sched_default.c
```c
/*
 * Copyright (c) 2017 Linaro Limited
 *
 * SPDX-License-Identifier: Apache-2.0
 */

#include <zephyr/zephyr.h>
#include <zephyr/device.h>
#include <zephyr/sys/printk.h>
#include <zephyr/kernel/thread_stack.h>
#include <string.h>

#define STACK_SIZE 1024

#define H_PRIORITY 3
#define M_PRIORITY 5
#define L_PRIORITY 7

struct k_thread t1_thread_data;
struct k_thread t2_thread_data;
struct k_thread t3_thread_data;

K_THREAD_STACK_DEFINE(t1_stack_area, STACK_SIZE);
K_THREAD_STACK_DEFINE(t2_stack_area, STACK_SIZE);
K_THREAD_STACK_DEFINE(t3_stack_area, STACK_SIZE);

void counter_thread(void * n, void * e, void * unused)
{
	int id = (int)n;
	int limit = (int)e;
	printk("T%d: HELLO\n", id);
	for (int i = 0; i < limit * 1000000; i++) {
		if (i % 1000000 == 0) {
			printk("T%d\n", id);
		}
	}
	printk("T%d: BYE\n", id);
}

int main()
{
	k_tid_t t1_tid = k_thread_create(&t1_thread_data, t1_stack_area,
					 K_THREAD_STACK_SIZEOF(t1_stack_area), 
					 counter_thread, ((void *)1), ((void *)1), NULL, L_PRIORITY, 0, K_NO_WAIT);

	k_tid_t t2_tid = k_thread_create(&t2_thread_data, t2_stack_area,
					 K_THREAD_STACK_SIZEOF(t2_stack_area), 
					 counter_thread, ((void*)2), ((void*)5), NULL, L_PRIORITY, 0, K_NO_WAIT);

	k_tid_t t3_tid = k_thread_create(&t3_thread_data, t3_stack_area,
					 K_THREAD_STACK_SIZEOF(t3_stack_area), 
					 counter_thread, ((void*)3), ((void*)10), NULL, L_PRIORITY, 0, K_NO_WAIT);
	return 0;
}
```

## src/sched_edf.c
```c
/*
 * Copyright (c) 2017 Linaro Limited
 *
 * SPDX-License-Identifier: Apache-2.0
 */

#include <zephyr/zephyr.h>
#include <zephyr/device.h>
#include <zephyr/sys/printk.h>
#include <zephyr/kernel/thread_stack.h>
#include <string.h>

#define STACK_SIZE 1024

#define H_PRIORITY 3
#define M_PRIORITY 5
#define L_PRIORITY 7

struct k_thread t1_thread_data;
struct k_thread t2_thread_data;
struct k_thread t3_thread_data;

K_THREAD_STACK_DEFINE(t1_stack_area, STACK_SIZE);
K_THREAD_STACK_DEFINE(t2_stack_area, STACK_SIZE);
K_THREAD_STACK_DEFINE(t3_stack_area, STACK_SIZE);

void counter_thread(void * n, void * e, void * unused)
{
	int id = (int)n;
	int limit = (int)e;
	printk("T%d: HELLO\n", id);
	for (int i = 0; i < limit * 1000000; i++) {
		if (i % 1000000 == 0) {
			printk("T%d\n", id);
		}
	}
	printk("T%d: BYE\n", id);
}

int main()
{
	k_tid_t t1_id = k_thread_create(&t1_thread_data, t1_stack_area,
					 K_THREAD_STACK_SIZEOF(t1_stack_area), 
					 counter_thread, ((void *)1), ((void *)1), NULL, M_PRIORITY, 0, K_SECONDS(3));

	k_tid_t t2_id = k_thread_create(&t2_thread_data, t2_stack_area,
					 K_THREAD_STACK_SIZEOF(t2_stack_area), 
					 counter_thread, ((void*)2), ((void*)5), NULL, L_PRIORITY, 0, K_SECONDS(3));

	k_tid_t t3_id = k_thread_create(&t3_thread_data, t3_stack_area,
					 K_THREAD_STACK_SIZEOF(t3_stack_area), 
					 counter_thread, ((void*)3), ((void*)10), NULL, L_PRIORITY, 0, K_SECONDS(3));

	k_thread_deadline_set(t1_id, 1000);
	k_thread_deadline_set(t2_id, 100);
	k_thread_deadline_set(t3_id, 10);

	return 0;
}
```

## src/sched_priority.c
```c
/*
 * Copyright (c) 2017 Linaro Limited
 *
 * SPDX-License-Identifier: Apache-2.0
 */

#include <zephyr/zephyr.h>
#include <zephyr/device.h>
#include <zephyr/sys/printk.h>
#include <zephyr/kernel/thread_stack.h>
#include <string.h>

#define STACK_SIZE 1024

#define H_PRIORITY 3
#define M_PRIORITY 5
#define L_PRIORITY 7

struct k_thread t1_thread_data;
struct k_thread t2_thread_data;
struct k_thread t3_thread_data;

K_THREAD_STACK_DEFINE(t1_stack_area, STACK_SIZE);
K_THREAD_STACK_DEFINE(t2_stack_area, STACK_SIZE);
K_THREAD_STACK_DEFINE(t3_stack_area, STACK_SIZE);

void counter_thread(void * n, void * e, void * unused)
{
	int id = (int)n;
	int limit = (int)e;
	printk("T%d: HELLO\n", id);
	for (int i = 0; i < limit * 1000000; i++) {
		if (i % 1000000 == 0) {
			printk("T%d\n", id);
		}
	}
	printk("T%d: BYE\n", id);
}

int main()
{
	k_tid_t t1_tid = k_thread_create(&t1_thread_data, t1_stack_area,
					 K_THREAD_STACK_SIZEOF(t1_stack_area), 
					 counter_thread, ((void *)1), ((void *)1), NULL, H_PRIORITY, 0, K_MSEC(20));

	k_tid_t t2_tid = k_thread_create(&t2_thread_data, t2_stack_area,
					 K_THREAD_STACK_SIZEOF(t2_stack_area), 
					 counter_thread, ((void*)2), ((void*)5), NULL, M_PRIORITY, 0, K_MSEC(10));

	k_tid_t t3_tid = k_thread_create(&t3_thread_data, t3_stack_area,
					 K_THREAD_STACK_SIZEOF(t3_stack_area), 
					 counter_thread, ((void*)3), ((void*)10), NULL, L_PRIORITY, 0, K_NO_WAIT);
	return 0;
}
```
